## boards/olimex_esp32_evb_esp32_procpu.conf
```kconfig
####################################
# ESP32 Ethernet
####################################
CONFIG_ETH_ESP32=y
CONFIG_NET_L2_ETHERNET=y
```

## main/Kconfig.projbuild
```kconfig
menu "Mender Reference App"

	config MENDER_APP_WIFI_SSID
		string "WIFI SSID - Network name"
		default "my_network"

	config MENDER_APP_WIFI_PSK
		string "WIFI PSK - Network password key"
		default "secret_passwd"

endmenu
```

## sdkconfig.defaults
```kconfig
# Target chip (without this a fresh clone builds for the default esp32)
CONFIG_IDF_TARGET="esp32s3"

# 8 MB flash on the devkit
CONFIG_ESPTOOLPY_FLASHSIZE_8MB=y
```
